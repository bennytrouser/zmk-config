## config/Boards/Shields/Benny5/Kconfig.shield
```kconfig
# Copyright (c) 2020 The ZMK Contributors
# SPDX-License-Identifier: MIT

config SHIELD_BENNY_LEFT
	def_bool $(shields_list_contains,BENNY_left)

config SHIELD_BENNY_RIGHT
	def_bool $(shields_list_contains,BENNY_right)
```

## config/Boards/Shields/benny/Kconfig.defconfig
```kconfig
# Copyright (c) 2020 The ZMK Contributors
# SPDX-License-Identifier: MIT

if SHIELD_BENNY_LEFT

config ZMK_KEYBOARD_NAME
	default "BENNY"

config ZMK_SPLIT_BLE_ROLE_CENTRAL
	default y

endif

if SHIELD_BENNY_LEFT || SHIELD_BENNY_RIGHT

config ZMK_SPLIT
	default y

endif
```

## config/board/shield/benny/Kconfig.shield
```kconfig
# Copyright (c) 2020 The ZMK Contributors
# SPDX-License-Identifier: MIT

config SHIELD_BENNY_LEFT
	def_bool $(shields_list_contains,benny_left)

config SHIELD_BENNY_RIGHT
	def_bool $(shields_list_contains,benny_right)
```

## config/boards/shields/nostrum/Kconfig.defconfig
```kconfig
# Copyright (c) 2020 The ZMK Contributors
# SPDX-License-Identifier: MIT

if SHIELD_NOSTRUM_LEFT

config ZMK_KEYBOARD_NAME
	default "NOSTRUM"

config ZMK_SPLIT_BLE_ROLE_CENTRAL
	default y

endif

if SHIELD_NOSTRUM_LEFT || SHIELD_NOSTRUM_RIGHT

config ZMK_SPLIT
	default y

endif
```

## config/boards/shields/nostrum/Kconfig.shield
```kconfig
# Copyright (c) 2020 The ZMK Contributors
# SPDX-License-Identifier: MIT

config SHIELD_NOSTRUM_LEFT
	def_bool $(shields_list_contains,nostrum_left)

config SHIELD_NOSTRUM_RIGHT
	def_bool $(shields_list_contains,nostrum_right)
```

## config/boards/shields/nostrumX/Kconfig.defconfig
```kconfig
# Copyright (c) 2020 The ZMK Contributors
# SPDX-License-Identifier: MIT

if SHIELD_NOSTRUMX_LEFT

config ZMK_KEYBOARD_NAME
	default "NostrumX"

config ZMK_SPLIT_BLE_ROLE_CENTRAL
	default y

endif

if SHIELD_NOSTRUMX_LEFT || SHIELD_NOSTRUMX_RIGHT

config ZMK_SPLIT
	default y

endif
```

## config/boards/shields/nostrumX/Kconfig.shield
```kconfig
# Copyright (c) 2020 The ZMK Contributors
# SPDX-License-Identifier: MIT

config SHIELD_NOSTRUMX_LEFT
	def_bool $(shields_list_contains,nostrumx_left)

config SHIELD_NOSTRUMX_RIGHT
	def_bool $(shields_list_contains,nostrumx_right)
```
