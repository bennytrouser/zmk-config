## config/boards/shields/nostrumchunky/Kconfig.defconfig
```kconfig
# Copyright (c) 2020 The ZMK Contributors
# SPDX-License-Identifier: MIT

if SHIELD_NOSTRUMCHUNKY_LEFT

config ZMK_KEYBOARD_NAME
	default "NostrumChunky"

config ZMK_SPLIT_BLE_ROLE_CENTRAL
	default y

endif

if SHIELD_NOSTRUMCHUNKY_LEFT || SHIELD_NOSTRUMCHUNKY_RIGHT

config ZMK_SPLIT
	default y

endif
```

## config/boards/shields/nostrumchunky/Kconfig.shield
```kconfig
# Copyright (c) 2020 The ZMK Contributors
# SPDX-License-Identifier: MIT

config SHIELD_NOSTRUMCHUNKY_LEFT
	def_bool $(shields_list_contains,nostrumchunky_left)

config SHIELD_NOSTRUMCHUNKY_RIGHT
	def_bool $(shields_list_contains,nostrumchunky_right)
```
