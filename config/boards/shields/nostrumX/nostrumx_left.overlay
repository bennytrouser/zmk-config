/*
 * Copyright (c) 2020 The ZMK Contributors
 *
 * SPDX-License-Identifier: MIT
 */

#include "nostrumx.dtsi"

&kscan0 {
	&kscan0 {
		row-gpios
			= <&xiao_d  0 (GPIO_PULL_DOWN | GPIO_ACTIVE_HIGH)>
			, <&xiao_d  1 (GPIO_PULL_DOWN | GPIO_ACTIVE_HIGH)>
			, <&xiao_d  2 (GPIO_PULL_DOWN | GPIO_ACTIVE_HIGH)>
			;
	
		col-gpios
			= <&xiao_d 3 GPIO_ACTIVE_HIGH>
			, <&xiao_d 4 GPIO_ACTIVE_HIGH>
			, <&xiao_d 5 GPIO_ACTIVE_HIGH>
			, <&xiao_d 6 GPIO_ACTIVE_HIGH>
			, <&xiao_d 7 GPIO_ACTIVE_HIGH>
			;
	};
};